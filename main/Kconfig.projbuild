## main/Kconfig.projbuild
```kconfig
menu "Drone controller"
config DRONE_SENSOR_DEBUG_MODE
    bool "Direct single-sensor debug mode (bypass TCA9548A)"
    default n
    help
        Connect one SDP3x directly to the configured SDA/SCL pins and send its
        data over native USB serial. TCA9548A is bypassed. Servo control remains
        available according to the selected servo mode. Only one default-address
        SDP3x may be connected.

config DRONE_I2C_SDA_GPIO
    int "I2C SDA GPIO"
    default 1
config DRONE_I2C_SCL_GPIO
    int "I2C SCL GPIO"
    default 2
config DRONE_I2C_FREQ_HZ
    int "I2C frequency (Hz)"
    default 400000
config DRONE_I2C_TIMEOUT_MS
    int "I2C timeout (ms)"
    default 20
config DRONE_TCA9548A_ADDR
    hex "TCA9548A address"
    default 0x70
config DRONE_SDP3X_ADDR
    hex "SDP3x address"
    default 0x21
config DRONE_SAMPLE_RATE_HZ
    int "Five-sensor output rate (Hz)"
    range 1 200
    default 200

menu "ESP32 WiFi collection page"
config DRONE_WIFI_AP_SSID
    string "SoftAP SSID"
    default "DronePressure"
config DRONE_WIFI_AP_PASSWORD
    string "SoftAP password (8+ characters)"
    default "pressure123"
config DRONE_WIFI_AP_CHANNEL
    int "SoftAP channel"
    range 1 13
    default 6
endmenu

menu "Atlas wireless serial link"
config DRONE_LINK_UART_NUM
    int "UART number"
    range 0 2
    default 1
config DRONE_LINK_TX_GPIO
    int "UART TX GPIO"
    default 17
config DRONE_LINK_RX_GPIO
    int "UART RX GPIO"
    default 18
config DRONE_LINK_BAUD_RATE
    int "Transparent serial baud rate"
    default 115200
config DRONE_LINK_WATCHDOG_MS
    int "Motion watchdog timeout (ms)"
    range 200 10000
    default 1000
endmenu

choice DRONE_FILTER_MODE
    prompt "Pressure filter"
    default DRONE_FILTER_KALMAN
config DRONE_FILTER_NONE
    bool "Disabled"
config DRONE_FILTER_EMA
    bool "Exponential moving average"
config DRONE_FILTER_MOVING_AVERAGE
    bool "Moving-window average"
config DRONE_FILTER_KALMAN
    bool "One-dimensional Kalman filter"
endchoice

config DRONE_FILTER_EMA_ALPHA_PERMILLE
    int "EMA alpha (1-1000 permille)"
    range 1 1000
    default 200
    depends on DRONE_FILTER_EMA
    help
        200 means alpha=0.2. Smaller values provide stronger smoothing but
        increase response delay.

config DRONE_FILTER_WINDOW_SIZE
    int "Moving-average window size"
    range 2 32
    default 10
    depends on DRONE_FILTER_MOVING_AVERAGE

config DRONE_FILTER_KALMAN_Q_MILLI
    int "Kalman process noise Q (0.001 Pa^2)"
    range 1 1000000
    default 30
    depends on DRONE_FILTER_KALMAN
    help
        Default 30 means Q=0.030 Pa^2. Increasing Q makes the filter track
        pressure changes faster but provides less smoothing.

config DRONE_FILTER_KALMAN_R_MILLI
    int "Kalman measurement noise R (0.001 Pa^2)"
    range 1 10000000
    default 20
    depends on DRONE_FILTER_KALMAN
    help
        Default 20 means R=0.020 Pa^2. Increasing R provides stronger
        smoothing but increases response delay.

choice DRONE_OUTPUT_FORMAT_CHOICE
    prompt "Default output format"
    default DRONE_OUTPUT_CSV
config DRONE_OUTPUT_CSV
    bool "CSV"
config DRONE_OUTPUT_JSON
    bool "JSON lines"
config DRONE_OUTPUT_BINARY
    bool "Binary"
endchoice
config DRONE_OUTPUT_FORMAT
    int
    default 0 if DRONE_OUTPUT_CSV
    default 1 if DRONE_OUTPUT_JSON
    default 2 if DRONE_OUTPUT_BINARY

choice DRONE_SERVO_MODE_CHOICE
    prompt "Servo control mode"
    default DRONE_SERVO_MODE_PULSE
config DRONE_SERVO_MODE_PULSE
    bool "Pulse + direction"
config DRONE_SERVO_MODE_MODBUS
    bool "RS485 Modbus RTU"
endchoice
config DRONE_SERVO_MODE
    int
    default 0 if DRONE_SERVO_MODE_PULSE
    default 1 if DRONE_SERVO_MODE_MODBUS
config DRONE_SERVO_PULSE_POS_GPIO
    int "Pulse+ GPIO"
    default 4
config DRONE_SERVO_PULSE_NEG_GPIO
    int "Pulse- GPIO"
    default 5
config DRONE_SERVO_DIR_POS_GPIO
    int "Direction+ GPIO"
    default 6
config DRONE_SERVO_DIR_NEG_GPIO
    int "Direction- GPIO (held low while moving)"
    default 7
config DRONE_SERVO_DIR_INVERT
    bool "Invert motion direction"
    default y
config DRONE_SERVO_DEFAULT_FREQ_HZ
    int "Default pulse/test-wave frequency (Hz)"
    default 10000
config DRONE_SERVO_MIN_FREQ_HZ
    int "Minimum ramp frequency (Hz)"
    default 200
config DRONE_SERVO_MAX_FREQ_HZ
    int "Maximum pulse frequency (Hz)"
    range 100 500000
    default 200000
config DRONE_SERVO_MAX_SPEED_MM_S
    int "Default software maximum speed (mm/s)"
    range 1 3000
    default 2000

config DRONE_RS485_UART_NUM
    int "RS485 UART number"
    default 2
config DRONE_RS485_TX_GPIO
    int "RS485 TX GPIO"
    default 17
config DRONE_RS485_RX_GPIO
    int "RS485 RX GPIO"
    default 18
config DRONE_RS485_DE_GPIO
    int "RS485 DE/RE GPIO"
    default 16
config DRONE_RS485_BAUD_RATE
    int "RS485 baud rate"
    default 9600
config DRONE_RS485_PARITY
    int
    default 0
config DRONE_RS485_STOP_BITS
    int
    default 3
config DRONE_MODBUS_SLAVE_ADDR
    int "P100S Modbus slave address"
    range 1 254
    default 1
config DRONE_MODBUS_TIMEOUT_MS
    int "Modbus timeout (ms)"
    default 100
endmenu
```

## sdkconfig.defaults
```kconfig
CONFIG_IDF_TARGET="esp32s3"
CONFIG_ESPTOOLPY_FLASHSIZE_16MB=y
CONFIG_SPIRAM=y
CONFIG_SPIRAM_MODE_OCT=y
CONFIG_ESP_CONSOLE_USB_SERIAL_JTAG=y
CONFIG_HTTPD_WS_SUPPORT=y
CONFIG_FREERTOS_HZ=1000
# CONFIG_DRONE_SENSOR_DEBUG_MODE is not set
CONFIG_DRONE_I2C_SDA_GPIO=1
CONFIG_DRONE_I2C_SCL_GPIO=2
CONFIG_DRONE_SAMPLE_RATE_HZ=200
CONFIG_DRONE_FILTER_KALMAN=y
CONFIG_DRONE_FILTER_KALMAN_Q_MILLI=30
CONFIG_DRONE_FILTER_KALMAN_R_MILLI=20
```
